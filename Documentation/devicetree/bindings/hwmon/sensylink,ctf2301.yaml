## drivers/gpu/drm/spacemit/Kconfig
```kconfig
# SPDX-License-Identifier: GPL-2.0

config DRM_SPACEMIT
	tristate "DRM Support for Spacemit"
	depends on DRM
	select DRM_CLIENT_SELECTION
	select DRM_KMS_HELPER
	select DRM_GEM_CMA_HELPER
	select DRM_KMS_CMA_HELPER
	select DRM_GEM_DMA_HELPER
	select DRM_FBDEV_EMULATION
	select DRM_MIPI_DSI
	select DRM_PANEL
	select VIDEOMODE_HELPERS
	select BACKLIGHT_CLASS_DEVICE
	select GKI_FIX_WORKAROUND if DRM_SPACEMIT=m
	default n
	help
	  Choose this option if you have a SPACEMIT chipsets.
	  If M is selected the module will be called spacemit-drm.

config SPACEMIT_INNO_DP
	tristate "Spacemit specific extensions for inno dp/edp"
	depends on DRM_SPACEMIT
	select DRM_DISPLAY_HELPER
	select DRM_DISPLAY_DP_HELPER
	select DRM_DISPLAY_DP_AUX_BUS
	default n
	help
	  Support for Spacemit SoC specific extensions for
	  the Innosilicon dp/edp driver.

config SPACEMIT_MIPI_PANEL
	tristate "mipi panel support for SPACEMIT SOCs platform"
	depends on DRM_SPACEMIT

config DRM_RASPBERRYPI_TOUCHSCREEN
	tristate "Raspberrypi Touchscreen"
	default y
	depends on DRM_SPACEMIT
	select DRM_KMS_HELPER
	select REGMAP_I2C
	select DRM_PANEL
	select DRM_MIPI_DSI

	help
	  Support for Raspberrypi Touchscreen driver.

source "drivers/gpu/drm/spacemit/backlight/Kconfig"
```

## drivers/gpu/drm/spacemit/backlight/Kconfig
```kconfig
# SPDX-License-Identifier: GPL-2.0
config DRM_SPACEMIT_BACKLIGHT
	tristate "Support for DRM SPACEMIT backlight"
	select BACKLIGHT_CLASS_DEVICE
	default n
	help
	  Choose this option if you have an SPACEMIT Soc with SPACEMIT backlight.
```

## drivers/gpu/drm/spacemit/selftest/Kconfig
```kconfig
# SPDX-License-Identifier: GPL-2.0
config DRM_SPACEMIT_SELFTEST
	tristate "SPACEMIT self test"
	depends on DRM_SPACEMIT
	default n
	help
		Choose this option if you want to test fbc mem size cal API.
```

## drivers/media/platform/spacemit/Kconfig
```kconfig
# SPDX-License-Identifier: GPL-2.0-only

comment "Spacemit media platform drivers"

source "drivers/media/platform/spacemit/vpu_k3/Kconfig"

source "drivers/media/platform/spacemit/cam_ccic/Kconfig"

source "drivers/media/platform/spacemit/cam_sensor/Kconfig"
```

## drivers/media/platform/spacemit/cam_ccic/Kconfig
```kconfig
# SPDX-License-Identifier: GPL-2.0
#
# spacemit camera configuration
#

comment "SPACEMIT K3 Camera And Video"

config SPACEMIT_K3_CCIC
    tristate "SPACEMIT K3 camera CCIC support"
    select VIDEOBUF2_CORE
    select VIDEOBUF2_V4L2
    select VIDEOBUF2_DMA_CONTIG
    select VIDEOBUF2_DMA_SG
    depends on VIDEO_DEV
    help
      Enable support for camera ccic

config SPACEMIT_K3_CCIC_IOMMU
	bool "SPACEMIT K3 camera CCIC IOMMU support"
	depends on SPACEMIT_K3_CCIC
    help
      Enable support for camera ccic iommu
```

## drivers/media/platform/spacemit/cam_sensor/Kconfig
```kconfig
# SPDX-License-Identifier: GPL-2.0
#
# spacemit sensor configuration
#

comment "SPACEMIT K3 Camera Sensor"

config SPACEMIT_K3_CAM_IMX219
	tristate "Sony IMX219 sensor support for K3"
	depends on SPACEMIT_K3_CCIC && I2C
	help
	  This is a i2c sensor driver for the Sony
	  IMX219 camera.

	  To compile this driver as a module, choose M here: the
	  module will be called imx219.

config SPACEMIT_K3_CAM_IMX415
	tristate "Sony IMX415 sensor support for K3"
	depends on SPACEMIT_K3_CCIC && I2C
	help
	  This is a i2c sensor driver for the Sony
	  IMX415 camera.

	  To compile this driver as a module, choose M here: the
	  module will be called imx219.

config SPACEMIT_K3_CAM_OV5647
	tristate "OmniVision OV5647 sensor support"
	depends on SPACEMIT_K3_CCIC && I2C
	help
	  This is a i2c sensor driver for the OmniVision
	  OV5647 camera.

	  To compile this driver as a module, choose M here: the
	  module will be called ov5647.

config SPACEMIT_K3_CAM_OV2735
	tristate "OmniVision OV2735 sensor support"
	depends on SPACEMIT_K3_CCIC && I2C
	help
	  This is a i2c sensor driver for the OmniVision
	  OV2735 camera.

	  To compile this driver as a module, choose M here: the
	  module will be called OV2735.

config SPACEMIT_K3_CAM_OV5640_MAX96724_MAX9295
	tristate "OV5640 over MAX96724/MAX9295 GMSL module support"
	depends on SPACEMIT_K3_CCIC && I2C
	help
	  This is a simplified I2C/ioctl sensor driver for the OV5640 sensor
	  connected through a MAX96724 deserializer and MAX9295 serializer.

	  It provides power, register initialization, stream control and
	  GMSL bring-up logic for the Spacemit K3 camera pipeline.
```

## drivers/media/platform/spacemit/camera/Kconfig
```kconfig
# SPDX-License-Identifier: GPL-2.0
#
# SPACEMIT Verification camera configuration
#

comment "SPACEMIT Camera Verification System"

menuconfig SPACEMIT_K3_VCAM
	tristate "SPACEMIT Camera Verification System support"
#	depends on VIDEO_V4L2
    depends on MEDIA_PLATFORM_DRIVERS
    default n
    help
	  Say Y here to enable selecting the video adapters for
	  SPACEMIT camera and video

config SPACEMIT_K3_VCAM_CCIC
    tristate "CCIC support"
    depends on SPACEMIT_K3_VCAM
    default n
    help
      enable support for ccic

config SPACEMIT_K3_VCAM_CCIC_DMA
    tristate "CCIC DMA support"
    depends on SPACEMIT_K3_VCAM
    default n
    help
      enable support for ccic dma

config SPACEMIT_K3_VCAM_SENSOR
    tristate "SENSOR support"
    depends on SPACEMIT_K3_VCAM
    default n
    help
      enable support for ccic
```

## drivers/net/ethercat/Kconfig
```kconfig
# SPDX-License-Identifier: GPL-2.0-only
#
# EtherCAT support
#

menuconfig ETHERCAT
	bool "EtherCAT support"
	depends on NET && NETDEVICES && ETHERNET
	help
	  EtherCAT is an industrial real-time fieldbus protocol that runs over
	  Ethernet frames (Layer 2). Selecting this option enables the EtherCAT
	  master subsystem and the corresponding network device interfaces.

if ETHERCAT

source "drivers/net/ethercat/master/Kconfig"
source "drivers/net/ethercat/device/Kconfig"

endif # ETHERCAT
```

## drivers/net/ethercat/device/Kconfig
```kconfig
# SPDX-License-Identifier: GPL-2.0-only
#
# EtherCAT device support
#

menuconfig EC_DEVICE
	tristate "EtherCAT device"
	depends on ETHERCAT && EC_MASTER
	help
	  Enable EtherCAT device support.

if EC_DEVICE

config EC_GENERIC
	tristate "Generic EtherCAT device support"
	depends on EC_MASTER
	help
	  Generic EtherCAT device support using the standard Linux networking
	  stack. This is portable but may have higher latency/jitter.

config EC_K1X_GMAC
	tristate "Spacemit K1 GMAC EtherCAT device support"
	depends on EC_MASTER && (SOC_SPACEMIT_K1 || COMPILE_TEST)
	help
	  EtherCAT device support for the Spacemit K1X GMAC controller.

config EC_K3_GMAC
	tristate "Spacemit K3 GMAC EtherCAT device support"
	depends on EC_MASTER && SOC_SPACEMIT_K3
	select PAGE_POOL
	help
	  EtherCAT device support for Spacemit K3 GMAC controller.

endif # EC_DEVICE
```

## drivers/net/ethercat/master/Kconfig
```kconfig
# SPDX-License-Identifier: GPL-2.0-only
#
# EtherCAT master support
#

config EC_MASTER
    tristate "EtherCAT master (IgH)"
    depends on ETHERCAT
    help
      Say Y or M here to build the IgH EtherCAT master driver.
      The master is controlled via a character device interface.
      If unsure, say N.

if EC_MASTER

config EC_MASTER_OF
    bool "Use Device Tree for EtherCAT master setup"
    depends on OF
    default y
    help
      Use Device Tree to provide EtherCAT master configuration,
      including master instances and bound Ethernet devices.

      This mode is intended for platform-integrated setups where
      EtherCAT master parameters are fixed by the board description,
      so runtime module parameters are not needed.

      If disabled, the original upstream module-parameter based
      configuration path is used instead.

if EC_MASTER_OF

config EC_MASTER_RUN_ON_CPU
    int "Run EtherCAT master on CPU"
    default 1
    range 0 7
    help
      Set the CPU (0-7) on which to run the EtherCAT master.
      If unsure, the default is 1.

config EC_MASTER_DEBUG_LEVEL
    int "Debug level for EtherCAT master"
    default 0
    range 0 2
    help
      Set the debug level for the EtherCAT master driver.
      0: No debug information.
      1: Error messages.
      2: Full debug information.

endif # EC_MASTER_OF

endif # EC_MASTER
```

## drivers/net/ethernet/vlsi/Kconfig
```kconfig
# SPDX-License-Identifier: GPL-2.0-only
#
# VLSI device configuration
#

config NET_VENDOR_VLSI
	bool "VLSI devices"
	default y
	help
	  If you have a network (Ethernet) card belonging to this class, say Y.

	  If unsure, say Y.

	  Note that the answer to this question doesn't directly affect the
	  kernel: saying N will just cause the configurator to skip all the
	  remaining Cadence network card questions. If you say Y, you will be
	  asked for your specific card in the following questions.

if NET_VENDOR_VLSI

config VLSI_MAC
	tristate "VLSI ethernet support"
	depends on COMMON_CLK
	select PHYLIB
	help
	  The VLSI ethernet interface is found on their VSRVES01 chip.
	  Say Y to include support chip.

	  To compile this driver as a module, choose M here: the module
	  will be vlsi-mac.

endif # NET_VENDOR_VLSI
```

## drivers/phy/spacemit/Kconfig
```kconfig
# SPDX-License-Identifier: GPL-2.0-only
#
# Phy drivers for SpacemiT platforms
#
config PHY_SPACEMIT_K1_USB2
	tristate "SpacemiT K1 USB 2.0 PHY support"
	depends on (ARCH_SPACEMIT || COMPILE_TEST) && OF
	depends on COMMON_CLK
	depends on USB_COMMON
	select GENERIC_PHY
	help
	  Enable this to support K1 USB 2.0 PHY driver. This driver takes care of
	  enabling and clock setup and will be used by K1 udc/ehci/otg/xhci driver.

config PHY_SPACEMIT_K3_USB3
	tristate "SpacemiT K3 USB 3.0 PHY support"
	depends on (ARCH_SPACEMIT || COMPILE_TEST) && OF
	depends on COMMON_CLK
	depends on USB_COMMON
	depends on TYPEC || TYPEC=n
	select GENERIC_PHY
	help
	  Enable this to support K3 USB 3.0 PHY driver. This driver takes care of
	  enabling and clock setup and will be used by K3 dwc3 driver.

config PHY_SPACEMIT_K3_PCIE
	tristate "SpacemiT K3 PCIe PHY support"
	depends on (ARCH_SPACEMIT || COMPILE_TEST) && OF
	depends on COMMON_CLK
	select GENERIC_PHY
	help
	  Enable this to support K3 PCIe PHY driver. This driver exposes the
	  PCIe PHY initialisation sequence implemented in the SpacemiT vendor
	  code via the generic PHY framework so that the K3 PCIe controller
	  can be wired up using standard DT \"phys\" bindings.
```

## drivers/soc/spacemit/Kconfig
```kconfig
# SPDX-License-Identifier: GPL-2.0-only

config SPACEMIT_HMP
	bool "Spacemit HMP support"
	depends on SMP && SOC_SPACEMIT
	help
	  Say y here to enable the HMP feature support.
	  This feature categorizes the CPU cores within the
	  SOC into two distinct types, each running different
	  types of threads.

config SPACEMIT_PM_DOMAINS
	bool "Spacemit generic power domain"
	depends on PM && MAILBOX
	select PM_GENERIC_DOMAINS
	help
	  Say y here to enable power domain support.
	  In order to meet high performance and low power requirements, a power
	  management unit is designed or saving power.

config SPACEMIT_REBOOT_CONTROL
	bool "Spacemit k3 reboot handler"
	depends on SOC_SPACEMIT_K3
	help
	  Say y here to support go to uboot fastboot when reset.

config SPACEMIT_SOCINFO
	tristate "Socinfo driver for spacemit SoCs"
	depends on SOC_SPACEMIT && NVMEM_SPACEMIT_EFUSE
	select MFD_SYSCON
	select SOC_BUS
	help
	  Spacemit SoCs information driver, which get information from efuse and
	  report to userspace.

config SPACEMIT_SUSPEND_AFFINITY
	bool "Spacemit k3 handle irq affinity when standby"
	depends on SOC_SPACEMIT_K3 && PM_SLEEP
	help
	  Say y here to handle irq affinity in resume process to migrate
	  back to cpu before suspend.

config SPACEMIT_POWERKEY_MONITOR
	bool "Spacemit power key monitor config"
	depends on SOC_SPACEMIT_K3
	help
	  Say y here to using gpio to monitor the power key

config SPACEMIT_DDR_BW
	tristate "Spacemit DDR bandwidth monitor"
	depends on SOC_SPACEMIT_K3
	help
	  Say y or m here to build the DDR bandwidth monitor driver.

source "drivers/soc/spacemit/v2d/Kconfig"
```

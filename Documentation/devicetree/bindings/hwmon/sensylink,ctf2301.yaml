## Documentation/devicetree/bindings/hwmon/sensylink,ctf2301.yaml
```yaml
# SPDX-License-Identifier: (GPL-2.0 OR BSD-2-Clause)
%YAML 1.2
---
$id: http://devicetree.org/schemas/hwmon/sensylink,ctf2301.yaml#
$schema: http://devicetree.org/meta-schemas/core.yaml#

title: Sensylink CTF2301 system-level thermal management solution chip

maintainers:
  - Troy Mitchell <troy.mitchell@linux.dev>

allOf:
  - $ref: hwmon-common.yaml#

description: |
  The CTF2301B is an I2C/SMBus compatible device featuring:
    - One local temperature sensor with ±0.5°C accuracy and 0.0625°C resolution.
    - One remote temperature sensor for external diode-connected transistors,
      offering ±1°C accuracy and 0.125°C resolution.
      (temperature range: -40°C to +125°C).
    - An integrated PWM fan controller.
    - A 1-channel fan speed monitor (TACH input) for RPM measurement.

  Datasheets:
    https://www.sensylink.com/upload/1/net.sensylink.portal/1689557281035.pdf

properties:
  compatible:
    const: sensylink,ctf2301

  reg:
    maxItems: 1

  sensylink,temp-signed:
    description: Temperature value is signed
    type: boolean

  sensylink,pwm-freq:
    description: |
      The initial PWM output frequency.
      This will likely only produce an approximation of the value you expect,
      not the exact one.
    $ref: /schemas/types.yaml#/definitions/uint32
    minimum: 360000
    maximum: 5800

required:
  - compatible
  - reg

unevaluatedProperties: false

examples:
  - |
    i2c {
        #address-cells = <1>;
        #size-cells = <0>;

        ctf2301@4c {
            compatible = "sensylink,ctf2301";
            reg = <0x4c>;
            sensylink,temp-signed;
            sensylink,pwm-freq = <360000>;
        };
    };
```

## Documentation/devicetree/bindings/pinctrl/eswin,eic7700-pinctrl.yaml
```yaml
# SPDX-License-Identifier: (GPL-2.0-only OR BSD-2-Clause)
%YAML 1.2
---
$id: http://devicetree.org/schemas/pinctrl/eswin,eic7700-pinctrl.yaml#
$schema: http://devicetree.org/meta-schemas/core.yaml#

title: ESWIN EIC7700 SoC pin controller

maintainers:
  - Emil Renner Berthing <emil.renner.berthing@canonical.com>

description:
  Pinmux and pinconf controller in the ESWIN EIC7700 RISC-V SoC.

properties:
  compatible:
    const: eswin,eic7700-pinctrl

  reg:
    maxItems: 1

patternProperties:
  '-[0-9]+$':
    type: object
    additionalProperties: false

    patternProperties:
      '-pins$':
        type: object

        additionalProperties: false

        description:
          A pinctrl node should contain at least one subnode describing one
          or more pads and their associated pinmux and pinconf settings.

        properties:
          pins:
            items:
              enum: [ CHIP_MODE, MODE_SET0, MODE_SET1, MODE_SET2, MODE_SET3,
                      XIN, RTC_XIN, RST_OUT_N, KEY_RESET_N, GPIO0, POR_SEL,
                      JTAG0_TCK, JTAG0_TMS, JTAG0_TDI, JTAG0_TDO, GPIO5, SPI2_CS0_N,
                      JTAG1_TCK, JTAG1_TMS, JTAG1_TDI, JTAG1_TDO, GPIO11, SPI2_CS1_N,
                      PCIE_CLKREQ_N, PCIE_WAKE_N, PCIE_PERST_N, HDMI_SCL, HDMI_SDA,
                      HDMI_CEC, JTAG2_TRST, RGMII0_CLK_125, RGMII0_TXEN,
                      RGMII0_TXCLK, RGMII0_TXD0, RGMII0_TXD1, RGMII0_TXD2,
                      RGMII0_TXD3, I2S0_BCLK, I2S0_WCLK, I2S0_SDI, I2S0_SDO,
                      I2S_MCLK, RGMII0_RXCLK, RGMII0_RXDV, RGMII0_RXD0, RGMII0_RXD1,
                      RGMII0_RXD2, RGMII0_RXD3, I2S2_BCLK, I2S2_WCLK, I2S2_SDI,
                      I2S2_SDO, GPIO27, GPIO28, GPIO29, RGMII0_MDC, RGMII0_MDIO,
                      RGMII0_INTB, RGMII1_CLK_125, RGMII1_TXEN, RGMII1_TXCLK,
                      RGMII1_TXD0, RGMII1_TXD1, RGMII1_TXD2, RGMII1_TXD3, I2S1_BCLK,
                      I2S1_WCLK, I2S1_SDI, I2S1_SDO, GPIO34, RGMII1_RXCLK,
                      RGMII2_RXDV, RGMII2_RXD0, RGMII2_RXD1, RGMII2_RXD2,
                      RGMII2_RXD3, SPI1_CS0_N, SPI1_CLK, SPI1_D0, SPI1_D1, SPI1_D2,
                      SPI1_D3, SPI1_CS1_N, RGMII1_MDC, RGMII1_MDIO, RGMII1_INTB,
                      USB0_PWREN, USB1_PWREN, I2C0_SCL, I2C0_SDA, I2C1_SCL, I2C1_SDA,
                      I2C2_SCL, I2C2_SDA, I2C3_SCL, I2C3_SDA, I2C4_SCL, I2C4_SDA,
                      I2C5_SCL, I2C5_SDA, UART0_TX, UART0_RX, UART1_TX, UART1_RX,
                      UART1_CTS, UART1_RTS, UART2_TX, UART2_RX, JTAG2_TCK, JTAG2_TMS,
                      JTAG2_TDI, JTAG2_TDO, FAN_PWM, FAN_TACH, MIPI_CSI0_XVS,
                      MIPI_CSI0_XHS, MIPI_CSI0_MCLK, MIPI_CSI1_XVS, MIPI_CSI1_XHS,
                      MIPI_CSI1_MCLK, MIPI_CSI2_XVS, MIPI_CSI2_XHS, MIPI_CSI2_MCLK,
                      MIPI_CSI3_XVS, MIPI_CSI3_XHS, MIPI_CSI3_MCLK, MIPI_CSI4_XVS,
                      MIPI_CSI4_XHS, MIPI_CSI4_MCLK, MIPI_CSI5_XVS, MIPI_CSI5_XHS,
                      MIPI_CSI5_MCLK, SPI3_CS_N, SPI3_CLK, SPI3_DI, SPI3_DO, GPIO92,
                      GPIO93, S_MODE, GPIO95, SPI0_CS_N, SPI0_CLK, SPI0_D0, SPI0_D1,
                      SPI0_D2, SPI0_D3, I2C10_SCL, I2C10_SDA, I2C11_SCL, I2C11_SDA,
                      GPIO106, BOOT_SEL0, BOOT_SEL1, BOOT_SEL2, BOOT_SEL3, GPIO111,
                      LPDDR_REF_CLK ]
            description: List of pads that properties in the node apply to.

          function:
            enum: [ csi, debug, ddr, fan, gpio, hdmi, i2c, i2s, jtag, mipi,
                    mode, oscillator, pci, pwm, rgmii, reset, sata, spi, sdio,
                    uart, usb ]
            description: The mux function to select for the given pins.

          bias-disable: true

          bias-pull-up: true

          bias-pull-down: true

          drive-strength-microamp:
            enum: [ 3100, 6700, 9600, 12900, 18000, 20900, 23200, 25900 ]

          input-enable: true

          input-disable: true

          input-schmitt-enable: true

          input-schmitt-disable: true

        required:
          - pins

        allOf:
          - $ref: /schemas/pinctrl/pincfg-node.yaml#
          - $ref: /schemas/pinctrl/pinmux-node.yaml#
          - if:
              properties:
                function:
                  const: rgmii
            then:
              properties:
                drive-strength-microamp:
                  enum: [ 3600, 6900, 10700, 13500, 17300, 20600, 23900, 26800 ]

required:
  - compatible
  - reg

additionalProperties: false

examples:
  - |
    pinctrl@51600080 {
        compatible = "eswin,eic7700-pinctrl";
        reg = <0x51600080 0x1fff80>;

        uart0_pins: uart0-0 {
            tx-pins {
                pins = "UART0_TX";
                function = "uart";
                bias-disable;
                drive-strength-microamp = <6700>;
                input-disable;
                input-schmitt-disable;
            };

            rx-pins {
                pins = "UART0_RX";
                function = "uart";
                bias-pull-up;
                drive-strength-microamp = <6700>;
                input-enable;
                input-schmitt-enable;
            };
        };
    };
```

## Documentation/devicetree/bindings/riscv/vlsi.yaml
```yaml
# SPDX-License-Identifier: (GPL-2.0-only OR MIT)
%YAML 1.2
---
$id: http://devicetree.org/schemas/riscv/vlsi.yaml#
$schema: http://devicetree.org/meta-schemas/core.yaml#

title: VLSI SoC-based boards

maintainers:
  - Emil Renner Berthing <emil.renner.berthing@canonical.com>

description:
  VLSI SoC-based boards

properties:
  $nodename:
    const: '/'
  compatible:
    oneOf:
      - items:
          - enum:
              - vlsi,vsrvse01-catboard
          - const: vlsi,vsrvse01

additionalProperties: true

...
```

## arch/riscv/configs/vsrves01_defconfig
```kconfig
CONFIG_KERNEL_UNCOMPRESSED=y
CONFIG_DEFAULT_HOSTNAME=""
CONFIG_SYSVIPC=y
CONFIG_POSIX_MQUEUE=y
CONFIG_GENERIC_IRQ_DEBUGFS=y
CONFIG_NO_HZ_IDLE=y
CONFIG_HIGH_RES_TIMERS=y
CONFIG_BPF_SYSCALL=y
CONFIG_BPF_JIT=y
CONFIG_BPF_JIT_ALWAYS_ON=y
CONFIG_TASKSTATS=y
CONFIG_BLK_DEV_INITRD=y
CONFIG_INITRAMFS_SOURCE="catboard.cpio"
# CONFIG_RD_GZIP is not set
# CONFIG_RD_BZIP2 is not set
# CONFIG_RD_LZMA is not set
# CONFIG_RD_XZ is not set
# CONFIG_RD_LZO is not set
# CONFIG_RD_LZ4 is not set
# CONFIG_RD_ZSTD is not set
CONFIG_LD_DEAD_CODE_DATA_ELIMINATION=y
CONFIG_EXPERT=y
# CONFIG_RSEQ is not set
CONFIG_PERF_EVENTS=y
CONFIG_ARCH_VLSI=y
CONFIG_NONPORTABLE=y
CONFIG_ARCH_RV32I=y
# CONFIG_RISCV_ISA_C is not set
# CONFIG_RISCV_ISA_ZAWRS is not set
# CONFIG_RISCV_ISA_ZBA is not set
# CONFIG_RISCV_ISA_ZBB is not set
# CONFIG_RISCV_ISA_ZBC is not set
# CONFIG_RISCV_ISA_ZBKB is not set
# CONFIG_RISCV_ISA_ZICBOM is not set
# CONFIG_RISCV_ISA_ZICBOZ is not set
# CONFIG_RISCV_ISA_ZICBOP is not set
# CONFIG_FPU is not set
# CONFIG_IRQ_STACKS is not set
# CONFIG_RISCV_ISA_VENDOR_EXT_ANDES is not set
# CONFIG_RISCV_ISA_VENDOR_EXT_SIFIVE is not set
# CONFIG_RISCV_ISA_VENDOR_EXT_THEAD is not set
CONFIG_RISCV_SBI_V01=y
CONFIG_CMDLINE="earlycon=uartlite,0x12000000 console=ttyUL0"
# CONFIG_EFI is not set
CONFIG_PHYS_RAM_BASE_FIXED=y
# CONFIG_SUSPEND is not set
CONFIG_JUMP_LABEL=y
# CONFIG_STACKPROTECTOR is not set
CONFIG_ARCH_MMAP_RND_BITS=17
# CONFIG_COMPAT_32BIT_TIME is not set
# CONFIG_RANDOMIZE_KSTACK_OFFSET is not set
# CONFIG_BLOCK is not set
CONFIG_SLUB_TINY=y
CONFIG_PAGE_REPORTING=y
# CONFIG_SECRETMEM is not set
CONFIG_NET=y
CONFIG_PACKET=y
CONFIG_UNIX=y
CONFIG_INET=y
CONFIG_IP_ADVANCED_ROUTER=y
CONFIG_IP_MULTIPLE_TABLES=y
CONFIG_INET_UDP_DIAG=y
CONFIG_INET_RAW_DIAG=y
# CONFIG_IPV6_SIT is not set
CONFIG_IPV6_MULTIPLE_TABLES=y
CONFIG_NETLINK_DIAG=y
# CONFIG_BQL is not set
# CONFIG_WIRELESS is not set
CONFIG_DEVTMPFS=y
CONFIG_DEVTMPFS_MOUNT=y
CONFIG_DEBUG_DRIVER=y
CONFIG_DEBUG_DEVRES=y
CONFIG_NETDEVICES=y
# CONFIG_NET_VENDOR_ALACRITECH is not set
# CONFIG_NET_VENDOR_AMAZON is not set
# CONFIG_NET_VENDOR_AQUANTIA is not set
# CONFIG_NET_VENDOR_ARC is not set
# CONFIG_NET_VENDOR_ASIX is not set
# CONFIG_NET_VENDOR_BROADCOM is not set
# CONFIG_NET_VENDOR_CADENCE is not set
# CONFIG_NET_VENDOR_CAVIUM is not set
# CONFIG_NET_VENDOR_CORTINA is not set
# CONFIG_NET_VENDOR_DAVICOM is not set
# CONFIG_NET_VENDOR_ENGLEDER is not set
# CONFIG_NET_VENDOR_EZCHIP is not set
# CONFIG_NET_VENDOR_FUNGIBLE is not set
# CONFIG_NET_VENDOR_GOOGLE is not set
# CONFIG_NET_VENDOR_HISILICON is not set
# CONFIG_NET_VENDOR_HUAWEI is not set
# CONFIG_NET_VENDOR_INTEL is not set
# CONFIG_NET_VENDOR_LITEX is not set
# CONFIG_NET_VENDOR_MARVELL is not set
# CONFIG_NET_VENDOR_META is not set
# CONFIG_NET_VENDOR_MICREL is not set
# CONFIG_NET_VENDOR_MICROCHIP is not set
# CONFIG_NET_VENDOR_MICROSEMI is not set
# CONFIG_NET_VENDOR_MICROSOFT is not set
# CONFIG_NET_VENDOR_NI is not set
# CONFIG_NET_VENDOR_NATSEMI is not set
# CONFIG_NET_VENDOR_NETRONOME is not set
# CONFIG_NET_VENDOR_PENSANDO is not set
# CONFIG_NET_VENDOR_QUALCOMM is not set
# CONFIG_NET_VENDOR_RENESAS is not set
# CONFIG_NET_VENDOR_ROCKER is not set
# CONFIG_NET_VENDOR_SAMSUNG is not set
# CONFIG_NET_VENDOR_SEEQ is not set
# CONFIG_NET_VENDOR_SOLARFLARE is not set
# CONFIG_NET_VENDOR_SOCIONEXT is not set
# CONFIG_NET_VENDOR_STMICRO is not set
# CONFIG_NET_VENDOR_SYNOPSYS is not set
# CONFIG_NET_VENDOR_VERTEXCOM is not set
# CONFIG_NET_VENDOR_VIA is not set
CONFIG_VLSI_MAC=y
# CONFIG_NET_VENDOR_WANGXUN is not set
# CONFIG_NET_VENDOR_WIZNET is not set
# CONFIG_NET_VENDOR_XILINX is not set
CONFIG_MICREL_PHY=y
# CONFIG_WLAN is not set
CONFIG_INPUT_EVDEV=y
# CONFIG_INPUT_KEYBOARD is not set
# CONFIG_INPUT_MOUSE is not set
# CONFIG_SERIO is not set
CONFIG_VT_HW_CONSOLE_BINDING=y
# CONFIG_LEGACY_PTYS is not set
# CONFIG_LEGACY_TIOCSTI is not set
# CONFIG_LDISC_AUTOLOAD is not set
CONFIG_SERIAL_8250=y
# CONFIG_SERIAL_8250_DEPRECATED_OPTIONS is not set
CONFIG_SERIAL_8250_CONSOLE=y
CONFIG_SERIAL_8250_EXTENDED=y
CONFIG_SERIAL_OF_PLATFORM=y
CONFIG_SERIAL_UARTLITE=y
CONFIG_SERIAL_UARTLITE_CONSOLE=y
# CONFIG_HW_RANDOM is not set
# CONFIG_DEVPORT is not set
# CONFIG_PTP_1588_CLOCK is not set
# CONFIG_HWMON is not set
# CONFIG_HID_SUPPORT is not set
# CONFIG_USB_SUPPORT is not set
# CONFIG_VIRTIO_MENU is not set
# CONFIG_VHOST_MENU is not set
# CONFIG_IOMMU_SUPPORT is not set
CONFIG_XILINX_INTC=y
# CONFIG_DNOTIFY is not set
CONFIG_FANOTIFY=y
CONFIG_AUTOFS_FS=y
CONFIG_PROC_CHILDREN=y
CONFIG_TMPFS=y
CONFIG_TMPFS_POSIX_ACL=y
# CONFIG_MISC_FILESYSTEMS is not set
# CONFIG_NETWORK_FILESYSTEMS is not set
CONFIG_NLS=y
CONFIG_NLS_DEFAULT="iso8859-15"
CONFIG_NLS_CODEPAGE_437=y
CONFIG_NLS_ISO8859_15=y
CONFIG_LSM=""
CONFIG_INIT_STACK_NONE=y
CONFIG_CRYPTO=y
CONFIG_CRYPTO_JITTERENTROPY=y
# CONFIG_CRYPTO_HW is not set
CONFIG_PRINTK_TIME=y
# CONFIG_DEBUG_MISC is not set
CONFIG_FRAME_WARN=2048
CONFIG_STRIP_ASM_SYMS=y
CONFIG_DEBUG_SECTION_MISMATCH=y
# CONFIG_SECTION_MISMATCH_WARN_ONLY is not set
CONFIG_DEBUG_FS=y
CONFIG_DEBUG_NET=y
CONFIG_SOFTLOCKUP_DETECTOR=y
# CONFIG_DETECT_HUNG_TASK_BLOCKER is not set
CONFIG_WQ_WATCHDOG=y
CONFIG_STACKTRACE=y
# CONFIG_FTRACE is not set
# CONFIG_RUNTIME_KERNEL_TESTING_MENU is not set
# CONFIG_RUNTIME_TESTING_MENU is not set
```

## drivers/clk/spacemit/Kconfig
```kconfig
# SPDX-License-Identifier: GPL-2.0-only

config SPACEMIT_CCU
	tristate "Clock support for SpacemiT SoCs"
	depends on ARCH_SPACEMIT || COMPILE_TEST
	select AUXILIARY_BUS
	select MFD_SYSCON
	help
	  Say Y to enable clock controller unit support for SpacemiT SoCs.

if SPACEMIT_CCU

config SPACEMIT_K1_CCU
	tristate "Support for SpacemiT K1 SoC"
	depends on SOC_SPACEMIT_K1 || COMPILE_TEST
	help
	  Support for clock controller unit in SpacemiT K1 SoC.

config SPACEMIT_K3_CCU
	tristate "Support for SpacemiT K3 SoC"
	depends on SOC_SPACEMIT_K3 || COMPILE_TEST
	help
	  Support for clock controller unit in SpacemiT K3 SoC.

endif
```

## drivers/gpu/drm/img-rogue/Kconfig
```kconfig
config POWERVR_ROGUE
	tristate "PowerVR GPU"
	default n
	depends on DRM
	help
	  Driver for PowerVR graphics processor hardware.

	  Say Y here if your SoC contains a PowerVR GPU. For more
	  information, see <http://www.imgtec.com/powervr/>.

config POWERVR_DVFS
	tristate "PowerVR GPU DVFS"
	default n
	depends on POWERVR_ROGUE && PM_DEVFREQ && PM_OPP
	select DEVFREQ_GOV_SIMPLE_ONDEMAND
	help
	  Enable Dynamic Voltage and Frequency Scaling (DVFS) support
	  for PowerVR GPU. This allows the GPU frequency and voltage to
	  be adjusted dynamically based on workload to optimize power
	  consumption and performance.

	  Requires kernel support for devfreq (CONFIG_PM_DEVFREQ) and
	  Operating Performance Points (CONFIG_PM_OPP).

	  Say Y here if you want to enable DVFS.

config POWERVR_THERMAL
	tristate "PowerVR GPU Thermal"
	default n
	depends on POWERVR_ROGUE && POWERVR_DVFS && DEVFREQ_THERMAL && K3_THERMAL
	help
	  Enable thermal management support for PowerVR GPU.
	  This allows the GPU to adjust frequency and voltage
	  based on thermal conditions.

	  Requires kernel support for devfreq thermal
	  (CONFIG_DEVFREQ_THERMAL) and K3 thermal
	  (CONFIG_K3_THERMAL).

	  Say Y here if you want to enable PowerVR thermal management.
```

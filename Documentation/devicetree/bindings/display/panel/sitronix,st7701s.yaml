## Documentation/devicetree/bindings/display/panel/sitronix,st7701s.yaml
```yaml
# SPDX-License-Identifier: (GPL-2.0-only OR BSD-2-Clause)
%YAML 1.2
---
$id: http://devicetree.org/schemas/display/panel/sitronix,st7701s.yaml#
$schema: http://devicetree.org/meta-schemas/core.yaml#

title: Sitronix ST7701 based LCD panels

maintainers:
  - Samuel Holland <samuel@sholland.org>

description: |
  Panel used on Lichee RV 86 Panel

allOf:
  - $ref: panel-common.yaml#
  - $ref: /schemas/spi/spi-peripheral-props.yaml#

properties:
  compatible:
    items:
      - const: sitronix,st7701s

  backlight: true

  reset-gpios: true

required:
  - compatible
  - reset-gpios

unevaluatedProperties: false
```

## Documentation/devicetree/bindings/pwm/allwinner,sun20i-pwm.yaml
```yaml
# SPDX-License-Identifier: (GPL-2.0-only OR BSD-2-Clause)
%YAML 1.2
---
$id: http://devicetree.org/schemas/pwm/allwinner,sun20i-pwm.yaml#
$schema: http://devicetree.org/meta-schemas/core.yaml#

title: Allwinner D1, T113-S3 and R329 PWM

maintainers:
  - Aleksandr Shubin <privatesub2@gmail.com>
  - Brandon Cheo Fusi <fusibrandon13@gmail.com>

properties:
  compatible:
    oneOf:
      - const: allwinner,sun20i-d1-pwm
      - items:
          - const: allwinner,sun20i-r329-pwm
          - const: allwinner,sun20i-d1-pwm

  reg:
    maxItems: 1

  "#pwm-cells":
    const: 3

  clocks:
    items:
      - description: Bus clock
      - description: 24 MHz oscillator
      - description: APB0 clock

  clock-names:
    items:
      - const: bus
      - const: hosc
      - const: apb0

  resets:
    maxItems: 1

  allwinner,pwm-channels:
    $ref: /schemas/types.yaml#/definitions/uint32
    description: The number of PWM channels configured for this instance
    enum: [6, 9]

allOf:
  - $ref: pwm.yaml#

  - if:
      properties:
        compatible:
          contains:
            const: allwinner,sun20i-r329-pwm

    then:
      required:
        - allwinner,pwm-channels

    else:
      properties:
        allwinner,pwm-channels: false

unevaluatedProperties: false

required:
  - compatible
  - reg
  - "#pwm-cells"
  - clocks
  - clock-names
  - resets

examples:
  - |
    #include <dt-bindings/clock/sun20i-d1-ccu.h>
    #include <dt-bindings/reset/sun20i-d1-ccu.h>

    pwm: pwm@2000c00 {
      compatible = "allwinner,sun20i-d1-pwm";
      reg = <0x02000c00 0x400>;
      clocks = <&ccu CLK_BUS_PWM>, <&dcxo>, <&ccu CLK_APB0>;
      clock-names = "bus", "hosc", "apb0";
      resets = <&ccu RST_BUS_PWM>;
      #pwm-cells = <0x3>;
    };

...
```

## Documentation/devicetree/bindings/pwm/pwm-sun8i-v536.txt
```
Allwinner sun8i-v536 SoC PWM controller

Required properties:
 - compatible: should be "allwinner,<name>-pwm"
   "allwinner,sun8i-v833-pwm"
   "allwinner,sun8i-v536-pwm"
   "allwinner,sun50i-r818-pwm"
   "allwinner,sun50i-a133-pwm"
   "allwinner,sun50i-r329-pwm"
 - reg: physical base address and length of the controller's registers
 - #pwm-cells: should be 3. See pwm.txt in this directory for a description of
   the cells format.
 - clocks: From common clock binding, handle to the parent clock.
 - resets: From reset clock binding, handle to the parent clock.

Example:

	pwm: pwm@300a0000 {
		compatible = "allwinner,sun50i-r818-pwm";
		reg = <0x0300a000 0x3ff>;
		clocks = <&ccu CLK_BUS_PWM>;
		resets = <&ccu RST_BUS_PWM>;
		#pwm-cells = <3>;
	};
```

## Documentation/devicetree/bindings/regulator/allwinner,sun20i-d1-analog-ldos.yaml
```yaml
# SPDX-License-Identifier: (GPL-2.0-only OR BSD-2-Clause)
%YAML 1.2
---
$id: http://devicetree.org/schemas/regulator/allwinner,sun20i-d1-analog-ldos.yaml#
$schema: http://devicetree.org/meta-schemas/core.yaml#

title: Allwinner D1 Analog LDOs

maintainers:
  - Samuel Holland <samuel@sholland.org>

description:
  Allwinner D1 contains a set of LDOs which are designed to supply analog power
  inside and outside the SoC. They are controlled by a register within the audio
  codec MMIO space, but which is not part of the audio codec clock/reset domain.

properties:
  compatible:
    enum:
      - allwinner,sun20i-d1-analog-ldos

  reg:
    maxItems: 1

  nvmem-cells:
    items:
      - description: NVMEM cell for the calibrated bandgap reference trim value

  nvmem-cell-names:
    items:
      - const: bg_trim

patternProperties:
  "^(a|hp)ldo$":
    type: object
    $ref: regulator.yaml#
    unevaluatedProperties: false

required:
  - compatible
  - reg
  - nvmem-cells
  - nvmem-cell-names

additionalProperties: false

examples:
  - |
    audio-codec@2030000 {
        compatible = "simple-mfd", "syscon";
        reg = <0x2030000 0x1000>;
        ranges;
        #address-cells = <1>;
        #size-cells = <1>;

        regulators@2030348 {
            compatible = "allwinner,sun20i-d1-analog-ldos";
            reg = <0x2030348 0x4>;
            nvmem-cells = <&bg_trim>;
            nvmem-cell-names = "bg_trim";

            reg_aldo: aldo {
                regulator-min-microvolt = <1800000>;
                regulator-max-microvolt = <1800000>;
            };

            reg_hpldo: hpldo {
                regulator-min-microvolt = <1800000>;
                regulator-max-microvolt = <1800000>;
            };
        };
    };

...
```

## arch/riscv/configs/hifive-premier-p550_defconfig
```kconfig
CONFIG_LOCALVERSION="-eic7700"
# CONFIG_LOCALVERSION_AUTO is not set
CONFIG_KERNEL_ZSTD=y
CONFIG_SYSVIPC=y
CONFIG_POSIX_MQUEUE=y
# CONFIG_CROSS_MEMORY_ATTACH is not set
CONFIG_NO_HZ_IDLE=y
CONFIG_HIGH_RES_TIMERS=y
CONFIG_BPF_SYSCALL=y
CONFIG_BPF_JIT=y
CONFIG_BPF_JIT_ALWAYS_ON=y
CONFIG_TASKSTATS=y
CONFIG_PSI=y
# CONFIG_CPU_ISOLATION is not set
CONFIG_IKCONFIG=m
CONFIG_IKCONFIG_PROC=y
CONFIG_LOG_BUF_SHIFT=18
CONFIG_CGROUPS=y
CONFIG_BLK_CGROUP=y
CONFIG_CGROUP_SCHED=y
CONFIG_CGROUP_PIDS=y
CONFIG_CGROUP_FREEZER=y
CONFIG_CPUSETS=y
# CONFIG_PROC_PID_CPUSET is not set
CONFIG_CGROUP_DEVICE=y
CONFIG_CGROUP_CPUACCT=y
CONFIG_CGROUP_BPF=y
CONFIG_CGROUP_MISC=y
CONFIG_NAMESPACES=y
CONFIG_BLK_DEV_INITRD=y
# CONFIG_RD_BZIP2 is not set
# CONFIG_RD_LZMA is not set
# CONFIG_RD_XZ is not set
# CONFIG_RD_LZO is not set
# CONFIG_RD_LZ4 is not set
CONFIG_EXPERT=y
# CONFIG_SYSFS_SYSCALL is not set
# CONFIG_RSEQ is not set
CONFIG_ARCH_ESWIN=y
CONFIG_ERRATA_ESWIN_EIC7700=y
CONFIG_NONPORTABLE=y
CONFIG_SMP=y
CONFIG_SCHED_MC=y
CONFIG_NR_CPUS=8
# CONFIG_RISCV_ISA_SVNAPOT is not set
# CONFIG_RISCV_ISA_SVPBMT is not set
# CONFIG_RISCV_ISA_V_DEFAULT_ENABLE is not set
# CONFIG_RISCV_ISA_ZAWRS is not set
# CONFIG_RISCV_ISA_ZICBOM is not set
# CONFIG_RISCV_ISA_VENDOR_EXT_ANDES is not set
# CONFIG_COMPAT is not set
CONFIG_CMDLINE="clk_ignore_unused"
CONFIG_CMDLINE_EXTEND=y
CONFIG_PM_DEBUG=y
CONFIG_PM_ADVANCED_DEBUG=y
CONFIG_CPU_FREQ=y
CONFIG_CPU_FREQ_GOV_POWERSAVE=m
CONFIG_CPU_FREQ_GOV_ONDEMAND=m
CONFIG_CPU_FREQ_GOV_CONSERVATIVE=m
CONFIG_CPUFREQ_DT=y
CONFIG_JUMP_LABEL=y
# CONFIG_STACKPROTECTOR is not set
# CONFIG_RANDOMIZE_KSTACK_OFFSET is not set
# CONFIG_GCC_PLUGINS is not set
CONFIG_MODULES=y
CONFIG_MODULE_UNLOAD=y
CONFIG_MODULE_SIG=y
CONFIG_MODULE_SIG_FORCE=y
CONFIG_MODULE_SIG_SHA256=y
CONFIG_MODULE_COMPRESS_ZSTD=y
CONFIG_MODULE_DECOMPRESS=y
CONFIG_TRIM_UNUSED_KSYMS=y
# CONFIG_BLOCK_LEGACY_AUTOLOAD is not set
# CONFIG_BLK_DEV_WRITE_MOUNTED is not set
CONFIG_BLK_WBT=y
# CONFIG_BLK_DEBUG_FS is not set
CONFIG_PARTITION_ADVANCED=y
# CONFIG_MQ_IOSCHED_DEADLINE is not set
# CONFIG_MQ_IOSCHED_KYBER is not set
CONFIG_BINFMT_MISC=m
CONFIG_SPARSEMEM_MANUAL=y
CONFIG_KSM=y
CONFIG_CMA=y
CONFIG_CMA_DEBUGFS=y
CONFIG_CMA_SYSFS=y
CONFIG_CMA_AREAS=7
# CONFIG_SECRETMEM is not set
CONFIG_LRU_GEN=y
CONFIG_LRU_GEN_ENABLED=y
CONFIG_NET=y
CONFIG_PACKET=y
CONFIG_PACKET_DIAG=m
CONFIG_UNIX=y
CONFIG_UNIX_DIAG=m
CONFIG_INET=y
CONFIG_IP_ADVANCED_ROUTER=y
CONFIG_IP_MULTIPLE_TABLES=y
# CONFIG_INET_DIAG is not set
# CONFIG_IPV6_SIT is not set
CONFIG_IPV6_MULTIPLE_TABLES=y
CONFIG_NETFILTER=y
# CONFIG_NETFILTER_INGRESS is not set
# CONFIG_NETFILTER_EGRESS is not set
CONFIG_NF_CONNTRACK=y
CONFIG_NF_LOG_SYSLOG=y
# CONFIG_NF_CT_PROTO_UDPLITE is not set
CONFIG_NF_CONNTRACK_IRC=y
CONFIG_NF_CT_NETLINK=y
CONFIG_NF_TABLES=y
CONFIG_NF_TABLES_INET=y
CONFIG_NFT_CT=y
CONFIG_NFT_LOG=y
CONFIG_NFT_LIMIT=y
CONFIG_NFT_MASQ=y
CONFIG_NFT_REDIR=y
CONFIG_NFT_NAT=y
CONFIG_NFT_REJECT=y
CONFIG_NET_SCHED=y
CONFIG_NET_SCH_FQ_CODEL=y
CONFIG_NETLINK_DIAG=y
# CONFIG_RPS is not set
# CONFIG_BQL is not set
CONFIG_RFKILL=m
CONFIG_PCI=y
CONFIG_PCIEPORTBUS=y
CONFIG_PCIEAER=y
CONFIG_PCIE_DPC=y
CONFIG_PCIE_PTM=y
# CONFIG_PCI_QUIRKS is not set
# CONFIG_VGA_ARB is not set
CONFIG_PCIE_ESWIN=y
CONFIG_DEVTMPFS=y
CONFIG_DEVTMPFS_MOUNT=y
CONFIG_DEVTMPFS_SAFE=y
# CONFIG_STANDALONE is not set
# CONFIG_PREVENT_FIRMWARE_BUILD is not set
CONFIG_FW_LOADER_COMPRESS=y
# CONFIG_FW_LOADER_COMPRESS_XZ is not set
CONFIG_FW_LOADER_COMPRESS_ZSTD=y
CONFIG_FW_UPLOAD=y
CONFIG_FIRMWARE_MEMMAP=y
CONFIG_FW_CFG_SYSFS=m
CONFIG_EFI_ZBOOT=y
CONFIG_EFI_DISABLE_RUNTIME=y
CONFIG_MTD=m
CONFIG_MTD_BLOCK_RO=m
CONFIG_MTD_PARTITIONED_MASTER=y
CONFIG_MTD_CFI=m
CONFIG_MTD_SPI_NAND=m
CONFIG_MTD_SPI_NOR=m
CONFIG_ZRAM=m
CONFIG_ZRAM_MEMORY_TRACKING=y
CONFIG_BLK_DEV_LOOP=m
CONFIG_BLK_DEV_LOOP_MIN_COUNT=1
CONFIG_BLK_DEV_NVME=y
CONFIG_SRAM=y
CONFIG_EEPROM_AT24=m
CONFIG_SCSI=y
# CONFIG_SCSI_PROC_FS is not set
CONFIG_BLK_DEV_SD=y
CONFIG_BLK_DEV_SR=m
CONFIG_CHR_DEV_SG=m
CONFIG_SCSI_CONSTANTS=y
CONFIG_SCSI_SCAN_ASYNC=y
# CONFIG_SCSI_LOWLEVEL is not set
CONFIG_ATA=m
# CONFIG_ATA_FORCE is not set
# CONFIG_SATA_PMP is not set
CONFIG_AHCI_ESWIN=m
# CONFIG_ATA_SFF is not set
CONFIG_NETDEVICES=y
CONFIG_WIREGUARD=m
CONFIG_TUN=m
CONFIG_STMMAC_ETH=m
# CONFIG_DWMAC_GENERIC is not set
CONFIG_DWMAC_EIC7700=m
# CONFIG_NET_VENDOR_VERTEXCOM is not set
# CONFIG_NET_VENDOR_WANGXUN is not set
CONFIG_MICREL_PHY=m
CONFIG_MICROSEMI_PHY=m
CONFIG_MOTORCOMM_PHY=m
# CONFIG_USB_NET_DRIVERS is not set
CONFIG_INPUT_EVDEV=y
# CONFIG_INPUT_KEYBOARD is not set
# CONFIG_INPUT_MOUSE is not set
# CONFIG_SERIO is not set
# CONFIG_LEGACY_PTYS is not set
# CONFIG_LEGACY_TIOCSTI is not set
# CONFIG_LDISC_AUTOLOAD is not set
CONFIG_SERIAL_8250=y
# CONFIG_SERIAL_8250_DEPRECATED_OPTIONS is not set
# CONFIG_SERIAL_8250_16550A_VARIANTS is not set
CONFIG_SERIAL_8250_CONSOLE=y
# CONFIG_SERIAL_8250_PCI is not set
# CONFIG_SERIAL_8250_EXAR is not set
CONFIG_SERIAL_8250_DW=y
# CONFIG_SERIAL_8250_PERICOM is not set
CONFIG_SERIAL_OF_PLATFORM=y
CONFIG_SERIAL_SIFIVE=y
CONFIG_SERIAL_SIFIVE_CONSOLE=y
# CONFIG_DEVMEM is not set
# CONFIG_DEVPORT is not set
# CONFIG_I2C_COMPAT is not set
CONFIG_I2C_CHARDEV=m
# CONFIG_I2C_HELPER_AUTO is not set
CONFIG_I2C_ALGOBIT=m
CONFIG_I2C_DESIGNWARE_PLATFORM=m
CONFIG_SPI=y
CONFIG_SPI_DESIGNWARE=m
CONFIG_SPI_DW_DMA=y
CONFIG_SPI_DW_MMIO=m
CONFIG_SPI_SPIDEV=m
# CONFIG_PTP_1588_CLOCK is not set
CONFIG_PINCTRL=y
CONFIG_PINCTRL_EIC7700=y
CONFIG_GPIOLIB=y
CONFIG_GPIOLIB_FASTPATH_LIMIT=256
CONFIG_GPIO_DWAPB=m
CONFIG_GPIO_GENERIC_PLATFORM=m
CONFIG_POWER_RESET=y
CONFIG_POWER_RESET_GPIO=y
CONFIG_POWER_RESET_GPIO_RESTART=y
CONFIG_POWER_RESET_SYSCON=y
CONFIG_POWER_RESET_SYSCON_POWEROFF=y
CONFIG_HWMON=m
CONFIG_SENSORS_PWM_FAN=m
CONFIG_THERMAL=y
CONFIG_THERMAL_NETLINK=y
CONFIG_THERMAL_STATISTICS=y
CONFIG_THERMAL_DEBUGFS=y
CONFIG_CPU_THERMAL=y
CONFIG_WATCHDOG=y
CONFIG_WATCHDOG_CORE=y
CONFIG_DW_WATCHDOG=m
CONFIG_REGULATOR=y
CONFIG_REGULATOR_FIXED_VOLTAGE=y
CONFIG_REGULATOR_NETLINK_EVENTS=y
CONFIG_DRM=m
CONFIG_FB=m
# CONFIG_FB_DEVICE is not set
CONFIG_BACKLIGHT_CLASS_DEVICE=m
CONFIG_BACKLIGHT_PWM=m
CONFIG_SOUND=m
CONFIG_SND=m
# CONFIG_SND_SUPPORT_OLD_API is not set
# CONFIG_SND_CTL_FAST_LOOKUP is not set
# CONFIG_SND_DRIVERS is not set
# CONFIG_SND_SPI is not set
CONFIG_SND_USB_AUDIO=m
CONFIG_SND_SOC=m
CONFIG_SND_DESIGNWARE_I2S=m
CONFIG_SND_DESIGNWARE_PCM=y
CONFIG_SND_SOC_SPDIF=m
CONFIG_SND_SIMPLE_CARD=m
# CONFIG_HID_SUPPORT is not set
CONFIG_USB_LED_TRIG=y
CONFIG_USB_ULPI_BUS=m
CONFIG_USB=y
CONFIG_USB_ANNOUNCE_NEW_DEVICES=y
CONFIG_USB_OTG=y
CONFIG_USB_OTG_FSM=m
CONFIG_USB_MON=m
CONFIG_USB_XHCI_HCD=y
CONFIG_USB_XHCI_DBGCAP=y
CONFIG_USB_XHCI_PLATFORM=y
CONFIG_USB_EHCI_HCD=m
CONFIG_USB_EHCI_HCD_PLATFORM=m
CONFIG_USB_OHCI_HCD=m
# CONFIG_USB_OHCI_HCD_PCI is not set
CONFIG_USB_OHCI_HCD_PLATFORM=m
CONFIG_USB_ACM=m
CONFIG_USB_STORAGE=y
CONFIG_USB_UAS=y
CONFIG_USB_SERIAL=m
CONFIG_USB_SERIAL_GENERIC=y
CONFIG_USB_SERIAL_SIMPLE=m
CONFIG_USB_SERIAL_CP210X=m
CONFIG_USB_SERIAL_FTDI_SIO=m
CONFIG_USB_SERIAL_PL2303=m
CONFIG_NOP_USB_XCEIV=m
CONFIG_USB_GADGET=y
CONFIG_USB_GADGET_VBUS_DRAW=500
CONFIG_U_SERIAL_CONSOLE=y
CONFIG_USB_CONFIGFS=m
CONFIG_USB_CONFIGFS_SERIAL=y
CONFIG_USB_CONFIGFS_ACM=y
CONFIG_USB_CONFIGFS_EEM=y
CONFIG_USB_ROLE_SWITCH=y
CONFIG_MMC=y
CONFIG_MMC_SDHCI=y
CONFIG_MMC_SDHCI_PLTFM=y
CONFIG_MMC_SDHCI_OF_ESWIN=y
CONFIG_MMC_SDHCI_OF_SDIO_ESWIN=y
CONFIG_MMC_SDHCI_CADENCE=y
CONFIG_MMC_SPI=y
CONFIG_MMC_DW=y
CONFIG_MMC_HSQ=m
CONFIG_NEW_LEDS=y
CONFIG_LEDS_CLASS=m
CONFIG_LEDS_CLASS_MULTICOLOR=m
CONFIG_LEDS_GPIO=m
CONFIG_LEDS_PWM=m
CONFIG_LEDS_PWM_MULTICOLOR=m
CONFIG_LEDS_TRIGGERS=y
CONFIG_LEDS_TRIGGER_HEARTBEAT=m
CONFIG_LEDS_TRIGGER_ACTIVITY=m
CONFIG_EDAC=y
# CONFIG_EDAC_LEGACY_SYSFS is not set
CONFIG_EDAC_SIFIVE=y
CONFIG_RTC_CLASS=y
CONFIG_RTC_DRV_ESWIN=m
CONFIG_RTC_DRV_GOLDFISH=y
# CONFIG_VIRTIO_MENU is not set
# CONFIG_VHOST_MENU is not set
CONFIG_COMMON_CLK_FIXED_MMIO=y
CONFIG_COMMON_CLK_EIC7700=y
CONFIG_IOMMU_ESWIN=y
CONFIG_PWM=y
CONFIG_RESET_ESWIN_EIC7700=y
CONFIG_RESET_GPIO=m
CONFIG_RESET_SIMPLE=y
CONFIG_GENERIC_PHY=y
CONFIG_NVMEM_U_BOOT_ENV=m
CONFIG_EXT4_FS=y
CONFIG_EXT4_FS_POSIX_ACL=y
CONFIG_EXT4_FS_SECURITY=y
CONFIG_BTRFS_FS=y
CONFIG_BTRFS_FS_POSIX_ACL=y
# CONFIG_DNOTIFY is not set
CONFIG_FANOTIFY=y
CONFIG_AUTOFS_FS=y
CONFIG_FUSE_FS=m
CONFIG_VFAT_FS=y
CONFIG_FAT_DEFAULT_IOCHARSET="iso8859-15"
CONFIG_FAT_DEFAULT_UTF8=y
CONFIG_PROC_CHILDREN=y
CONFIG_TMPFS=y
CONFIG_TMPFS_POSIX_ACL=y
CONFIG_TMPFS_INODE64=y
# CONFIG_MISC_FILESYSTEMS is not set
# CONFIG_NETWORK_FILESYSTEMS is not set
CONFIG_NLS_DEFAULT="iso8859-15"
CONFIG_NLS_CODEPAGE_437=y
CONFIG_NLS_ISO8859_15=y
CONFIG_NLS_UTF8=m
CONFIG_KEY_DH_OPERATIONS=y
CONFIG_LSM=""
CONFIG_INIT_STACK_NONE=y
CONFIG_CRYPTO_USER=m
CONFIG_CRYPTO_ECDH=m
CONFIG_CRYPTO_AES=m
CONFIG_CRYPTO_AES_TI=m
CONFIG_CRYPTO_DES=m
CONFIG_CRYPTO_CBC=m
CONFIG_CRYPTO_CCM=m
CONFIG_CRYPTO_GCM=m
CONFIG_CRYPTO_CMAC=m
CONFIG_CRYPTO_MD4=m
CONFIG_CRYPTO_MD5=m
CONFIG_CRYPTO_SHA1=m
CONFIG_CRYPTO_SM3_GENERIC=m
CONFIG_CRYPTO_ZSTD=m
CONFIG_CRYPTO_USER_API_HASH=m
CONFIG_CRYPTO_USER_API_SKCIPHER=m
CONFIG_CRYPTO_USER_API_RNG=m
CONFIG_CRYPTO_USER_API_AEAD=m
# CONFIG_CRYPTO_USER_API_ENABLE_OBSOLETE is not set
# CONFIG_RAID6_PQ_BENCHMARK is not set
CONFIG_CRC_CCITT=m
CONFIG_XZ_DEC=m
# CONFIG_XZ_DEC_X86 is not set
# CONFIG_XZ_DEC_POWERPC is not set
# CONFIG_XZ_DEC_ARM is not set
# CONFIG_XZ_DEC_ARMTHUMB is not set
# CONFIG_XZ_DEC_SPARC is not set
CONFIG_SWIOTLB_DYNAMIC=y
CONFIG_DMA_CMA=y
CONFIG_PRINTK_TIME=y
# CONFIG_DEBUG_MISC is not set
CONFIG_STRIP_ASM_SYMS=y
CONFIG_DEBUG_SECTION_MISMATCH=y
# CONFIG_SECTION_MISMATCH_WARN_ONLY is not set
# CONFIG_FRAME_POINTER is not set
CONFIG_DEBUG_FS=y
# CONFIG_SLUB_DEBUG is not set
CONFIG_DEBUG_WX=y
CONFIG_SOFTLOCKUP_DETECTOR=y
CONFIG_WQ_WATCHDOG=y
# CONFIG_SCHED_DEBUG is not set
CONFIG_STACKTRACE=y
CONFIG_RCU_CPU_STALL_TIMEOUT=60
# CONFIG_RCU_TRACE is not set
# CONFIG_FTRACE is not set
# CONFIG_RUNTIME_TESTING_MENU is not set
```

## drivers/clk/eswin/Kconfig
```kconfig
# SPDX-License-Identifier: GPL-2.0-only

config COMMON_CLK_EIC7700
	bool "EIC7700 Clock Driver"
	depends on ARCH_ESWIN || COMPILE_TEST
	default ARCH_ESWIN
	help
	  Build the Eswin EIC7700 clock driver based on the common clock framework.
```

## drivers/gpu/drm/nulldisp/Kconfig
```kconfig
# SPDX-License-Identifier: GPL-2.0
config POWERVR_ROGUE_NULLDRMDISP
	tristate "null drm disp"
	default n
	select DRM_KMS_HELPER
	depends on POWERVR_ROGUE
        help
          This enables powervr null drm display driver
```
